## sagit-device-source-OpenHarmony6.1.0.35/device-source/device/soc/qualcomm/msm8998/soc/Kconfig
```kconfig
# SPDX-License-Identifier: GPL-2.0
menu "Vendor Drivers"

source "vendor/qualcomm/Kconfig"

source "vendor/drivers/Kconfig"

endmenu
```

## sagit-device-source-OpenHarmony6.1.0.35/device-source/device/soc/qualcomm/msm8998/soc/qualcomm/Kconfig
```kconfig
#
# Qualcomm driver configuration
#
config QCOM_DRIVER
	bool "Qualcomm Peripheral drivers"
	default n
	help
		this option is provided for control qualcomm
		drivers, if you want to use amlogic driver
		please open it

if QCOM_DRIVER
menu "Qualcomm Device Drivers"
source "vendor/qualcomm/reboot/Kconfig"
endmenu
endif
```

## sagit-device-source-OpenHarmony6.1.0.35/device-source/device/soc/qualcomm/msm8998/soc/qualcomm/reboot/Kconfig
```kconfig
# Qualcomm POWER OFF
config QCOM_REBOOT
	bool "Qualcomm Board level reboot or power off"
	default n
    help
		This is the Qualcomm Board reboot or poweroff driver.
```
